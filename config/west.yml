## config/west.yml
```yaml
manifest:
  remotes:
    - name: zmkfirmware
      url-base: https://github.com/zmkfirmware
    # dongle_display
    - name: englmaxi
      url-base: https://github.com/englmaxi
    # nice_oled - nice_epaper - dongle_display!view - oled Adapter
    - name: mctechnology17
      url-base: https://github.com/mctechnology17
    - name: ykiewang
      url-base: https://github.com/ykiewang
  projects:
    - name: zmk
      remote: zmkfirmware
      revision: 6b44d33db2f4bad7d98e475e6f7968493b05af73
      import: app/west.yml
    # dongle_display
    - name: zmk-dongle-display
      remote: englmaxi
      revision: caa901038d806312c71c290c99e08b05112b8072
    # nice_oled - nice_epaper
    - name: zmk-nice-oled
      remote: mctechnology17
      revision: 5d7dce25735277dd6dcd8295c64e143d4f95cdfa
    # dongle_display!view
    - name: zmk-dongle-display-view
      remote: mctechnology17
      revision: 05bf62b4ee0858cd8801b07aa6cc6716d210932d
    # oled Adapter
    - name: zmk-oled-adapter
      remote: mctechnology17
      revision: 9b862f63010cbcb5f5ad3d96bc9156099bf560ba
    - name: zmk-keybeacon
      remote: ykiewang
      revision: v1.1.1
  self:
    path: config
```
